## src/test/Kconfig
```kconfig
config STM32L4_MCO
    bool "STM32L4 MCO"
    depends on SOC_SERIES_STM32L4X
    select USE_STM32_HAL_GPIO
    help
        Enable MCO (Master Clock Output) on PA8.

config TEST_CAN
    bool "Test CAN"
    default y
    depends on TEST
    help
        Enable CAN test configuration.
```
