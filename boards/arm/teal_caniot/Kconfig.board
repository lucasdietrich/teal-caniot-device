## boards/arm/teal_caniot/Kconfig.board
```kconfig
#
# Copyright (c) 2024 Lucas Dietrich <ld.adecy@gmail.com>
#
# SPDX-License-Identifier: Apache-4.0
#

config BOARD_TEAL_CANIOT
	bool "Teal Caniot"
	depends on SOC_STM32F072XB
```

## boards/arm/teal_caniot/Kconfig.defconfig
```kconfig
#
# Copyright (c) 2024 Lucas Dietrich <ld.adecy@gmail.com>
#
# SPDX-License-Identifier: Apache-4.0
#

if BOARD_TEAL_CANIOT

config BOARD
    default "teal_caniot"

endif
```

## boards/arm/teal_caniot/Kconfig.teal_caniot
```kconfig
#
# Copyright (c) 2024 Lucas Dietrich <ld.adecy@gmail.com>
#
# SPDX-License-Identifier: Apache-4.0
#

config BOARD_TEAL_CANIOT
	select SOC_STM32L462XX
```

## boards/arm/teal_caniot/teal_caniot_defconfig
```kconfig
#
# Copyright (c) 2024 Lucas Dietrich <ld.adecy@gmail.com>
#
# SPDX-License-Identifier: Apache-2.0
#


CONFIG_ARM_MPU=y
CONFIG_HW_STACK_PROTECTION=y

CONFIG_CLOCK_CONTROL=y

CONFIG_PINCTRL=y

CONFIG_SERIAL=y

CONFIG_CONSOLE=y
CONFIG_UART_CONSOLE=y
CONFIG_UART_LINE_CTRL=y

CONFIG_I2C=y
CONFIG_SPI=y
CONFIG_GPIO=y
CONFIG_ADC=y
CONFIG_CAN=y
CONFIG_CRC=y
CONFIG_W1=y

# usb
CONFIG_USB_CDC_ACM=y
CONFIG_USB_DEVICE_STACK=y
CONFIG_USB_DEVICE_MANUFACTURER="Lucas"
CONFIG_USB_DEVICE_PRODUCT="Teal CANIoT"

# st microelectronics
CONFIG_USB_DEVICE_VID=0x0483
CONFIG_USB_DEVICE_PID=0xFFFF

# tcn75
CONFIG_SENSOR=y
CONFIG_TCN75A=y
```

## boards/arm/teal_f072/Kconfig.defconfig
```kconfig
#
# Copyright (c) 2024 Lucas Dietrich <ld.adecy@gmail.com>
#
# SPDX-License-Identifier: Apache-4.0
#

if BOARD_TEAL_F072

config BOARD
    default "teal_f072"

endif
```

## boards/arm/teal_f072/Kconfig.teal_f072
```kconfig
#
# Copyright (c) 2024 Lucas Dietrich <ld.adecy@gmail.com>
#
# SPDX-License-Identifier: Apache-4.0
#

config BOARD_TEAL_F072
	select SOC_STM32F072XB
```
